## boards/lilygo-t-display-gd32/Kconfig
```kconfig
# Copyright (c) 2023 Inria
#
# This file is subject to the terms and conditions of the GNU Lesser
# General Public License v2.1. See the file LICENSE in the top level
# directory for more details.
#

config BOARD
    default "lilygo-t-display-gd32" if BOARD_LILYGO_T_DISPLAY_GD32

config BOARD_LILYGO_T_DISPLAY_GD32
    bool
    default y
    select CPU_MODEL_GD32VF103C8T6
    select BOARD_HAS_HXTAL
    select BOARD_HAS_LXTAL
    select HAS_PERIPH_ADC
    select HAS_PERIPH_DAC
    select HAS_PERIPH_I2C
    select HAS_PERIPH_PWM
    select HAS_PERIPH_SPI
    select HAS_PERIPH_TIMER
    select HAS_PERIPH_UART
    select HAS_PERIPH_USBDEV
    select HAS_RIOTBOOT
    select HAS_TINYUSB_DEVICE
    select HAVE_SAUL_GPIO
    select HAVE_ST7789

    select HAVE_MTD_SDCARD_DEFAULT
    select MODULE_FATFS_VFS if MODULE_VFS_DEFAULT

source "$(RIOTBOARD)/common/gd32v/Kconfig"
```

## drivers/st7735/Kconfig
```kconfig
# Copyright (c) 2020 HAW Hamburg
#               2023 Gunar Schorcht
#
# This file is subject to the terms and conditions of the GNU Lesser
# General Public License v2.1. See the file LICENSE in the top level
# directory for more details.
#

config MODULE_ST7735
    bool "ST7735 display driver"
    depends on HAS_PERIPH_SPI
    depends on HAS_PERIPH_GPIO
    depends on TEST_KCONFIG
    select MODULE_PERIPH_SPI
    select MODULE_PERIPH_GPIO
    select MODULE_LCD
    select MODULE_ZTIMER
    select MODULE_ZTIMER_MSEC

config HAVE_ST7735
    bool
    select MODULE_ST7735 if MODULE_DISP_DEV
    help
      Indicates that an ST7735 display is present.

config MODULE_ST7789
    bool
    depends on HAVE_ST7789
    default y if MODULE_ST7735
    help
        ST7789 display driver

config HAVE_ST7789
    bool
    select MODULE_ST7735 if MODULE_DISP_DEV
    help
      Indicates that an ST7789 display is present.

menuconfig KCONFIG_USEMODULE_ST7735
    bool "Configure ST7735 driver"
    depends on USEMODULE_ST7735
    help
        Configure the ST7735 display driver using Kconfig.

if KCONFIG_USEMODULE_ST7735

config ST7735_CUSTOM_CONFIG
    bool "ST7735 Custom Configuration"
    depends on !MODULE_ST7789 && !MODULE_ST7796
    help
        Enable if customized configuration of voltages are needed. Otherwise
        reset default values are used.

if ST7735_CUSTOM_CONFIG

config ST7735_AVDD
    int "AVDD voltage (in millivolts)"
    default 4900
    range 4500 5100
    help
        Configure the AVDD voltage for analog circuits in millivolts.
        Valid values must be in the range of 4500 (4.5V) to 5100 (5.1V)
        in steps of 100.

config ST7735_GVDD
    int "GVDD voltage (in millivolts)"
    default 4600
    range 3150 4700
    help
        Configure the GVDD voltage, the gamma reference positive voltage.
        Valid values must be in the range of 3150 (3.15V) to 4700 (4.7V)
        in steps of 50.

config ST7735_GVCL
    int "GVCL voltage (in millivolts)"
    default -4600
    range -4700 -3150
    help
        Configure the GVCL voltage, the gamma reference negative voltage.
        Valid values must be in the range of -4700 (-4.7V) to -3150 (-3.15V)
        in steps of 50.

config ST7735_VCOM
    int "VCOM voltage (in millivolts)"
    default -775
    range -2000 -425
    help
        Configure the VCOM voltage. VCOM needs to be adjusted to match the
        capacitance and performance specifications of the TFT panel to
        maximize contrast and minimize flickering.
        Valid values must be in the range of -2000 (-2.0V) to -425 (-0.425V)
        in steps of 25.

config ST7735_VGH
    int "VGH voltage (in millivolts)"
    default 14700
    range 10000 15000
    help
        Configure the high voltage for gate drivers in millivolts.
        Valid values must be in the range of 10000 (10V) to 15000 (15V) and
        in the range of (2 * AVDD + 2.1V) and (3 * AVDD + 2.4 V).

config ST7735_VGL
    int "VGL voltage (in millivolts)"
    default -10000
    range -13000 -7500
    help
        Configure the low voltage for gate drivers in millivolts.
        Valid values must be in the range of -13000 (-13V) to -7500 (-7.5V)
        in steps of 2500.

endif # ST7735_CUSTOM_CONFIG

config ST7789_CUSTOM_CONFIG
    bool "ST7789 Custom Configuration"
    depends on MODULE_ST7789
    help
        Enable if customized configuration of voltages are needed. Otherwise
        reset default values are used.

if ST7789_CUSTOM_CONFIG

config ST7789_AVDD
    int "AVDD voltage (in millivolts)"
    default 6600
    range 6400 6800
    help
        Configure the AVDD voltage for analog circuits in millivolts.
        Valid values must be in the range of 6400 (6.4V) to 6800 (6.8V)
        in steps of 200.

config ST7789_AVCL
    int "AVDD voltage (in millivolts)"
    default -4400
    range -5000 -4400
    help
        Configure the AVCL voltage in millivolts.
        Valid values must be in the range of -5000 (-5V) to -4400 (-4.4V)
        in steps of 200.

config ST7789_VCOM
    int "VCOM voltage (in millivolts)"
    default 900
    range 100 1675
    help
        Configure the VCOM voltage level. VCOM needs to be adjusted
        to match the capacitance and performance specifications of the TFT panel
        to maximize contrast and minimize flickering. VCOM is used to derive
        the GVDD (gamma reference positive voltage) and the GVCL (gamma
        reference negative voltage) as follows:

            GDDV = +VRH + VCOM + VCOM_OFFSET + (0.5 * VDV)
            GVCL = -VRH + VCOM + VCOM_OFFSET - (0.5 * VDV)

        Valid values must be in the range of 100 (0.1V) to 1675 (1.675V)
        in steps of 25.

config ST7789_VCOM_OFFSET
    int "VCOM voltage offset (in millivolts)"
    default 0
    range -800 775
    help
        Configure the VCOM voltage offset (VCOM_OFFSET). VCOM_OFFSET is used to
        derive the GVDD (gamma reference positive voltage) and the GVCL (gamma
        reference negative voltage) as follows:

            GDDV = +VRH + VCOM + VCOM_OFFSET + (0.5 * VDV)
            GVCL = -VRH + VCOM + VCOM_OFFSET - (0.5 * VDV)

        Valid values must be in the range of -800 (-0.8V) to 775 (0.775V)
        in steps of 25.

config ST7789_VDV
    int "VDV voltage offset factor (in millivolts)"
    default 0
    range -800 775
    help
        Configure the VDV voltage offset factor. VDV is used to derive the GVDD
        (gamma reference positive voltage) and the GVCL (gamma reference
        negative voltage) as follows:

            GDDV = +VRH + VCOM + VCOM_OFFSET + (0.5 * VDV)
            GVCL = -VRH + VCOM + VCOM_OFFSET - (0.5 * VDV)

        Valid values must be in the range of -800 (-0.8V) to 775 (0.775V)
        in steps of 25.

config ST7789_VRH
    int "VRH voltage range (in millivolts)"
    default 4100
    range 3550 5500
    help
        Configure the VRH voltage range. VRH is used to derive the GVDD (gamma
        reference positive voltage) and the GVCL (gamma reference negative
        voltage) as follows:

            GDDV = +VRH + VCOM + VCOM_OFFSET + (0.5 * VDV)
            GVCL = -VRH + VCOM + VCOM_OFFSET - (0.5 * VDV)

        Valid values must be in the range of 3350 (3.35V) to 5500 (5.5V)
        in steps of 50.

# TODO  ST7789_VGH and ST7789_VGL (non linear values)

endif # ST7789_CUSTOM_CONFIG

config ST7796_CUSTOM_CONFIG
    bool "ST7796 Custom Configuration"
    depends on MODULE_ST7796
    help
        Enable if customized configuration of voltages are needed. Otherwise
        reset default values are used.

if ST7796_CUSTOM_CONFIG

config ST7796_AVDD
    int "AVDD voltage (in millivolts)"
    default 6600
    range 6200 6800
    help
        Configure the AVDD voltage for analog circuits in millivolts.
        Valid values must be in the range of 6200 (6.2V) to 6800 (6.8V)
        in steps of 200.

config ST7796_AVCL
    int "AVDD voltage (in millivolts)"
    default -4400
    range -5000 -4400
    help
        Configure the AVCL voltage in millivolts.
        Valid values must be in the range of -5000 (-5V) to -4400 (-4.4V)
        in steps of 200.

config ST7796_VCOM
    int "VCOM voltage (in millivolts)"
    default 1000
    range 300 1875
    help
        Configure the VCOM voltage level. VCOM needs to be adjusted to match
        the capacitance and performance specifications of the TFT panel to
        maximize contrast and minimize flickering. VCOM is used to derive the
        GVDD (gamma reference positive voltage) and the GVCL (gamma reference
        negative voltage) as follows:

            GDDV = +VRH + VCOM + VCOM_OFFSET
            GVCL = -VRH + VCOM + VCOM_OFFSET

        Valid values must be in the range of 300 (0.3V) to 1875 (1.875V)
        in steps of 25.

config ST7796_VCOM_OFFSET
    int "VCOM voltage offset (in millivolts)"
    default 0
    range -800 775
    help
        Configure the VCOM voltage offset (VCOM_OFFSET). VCOM_OFFSET is used to
        derive the GVDD (gamma reference positive voltage) and the GVCL (gamma
        reference negative voltage) as follows:

            GDDV = +VRH + VCOM + VCOM_OFFSET
            GVCL = -VRH + VCOM + VCOM_OFFSET

        Valid values must be in the range of -800 (-0.8V) to 775 (0.775V)
        in steps of 25.

config ST7796_VRH
    int "VRH voltage range (in millivolts)"
    default 4500
    range 3550 5500
    help
        Configure the VRH voltage range. VRH is used to derive the GVDD (gamma
        reference positive voltage) and the GVCL (gamma reference negative
        voltage) as follows:

            GDDV = +VRH + VCOM + VCOM_OFFSET + (0.5 * VDV)
            GVCL = -VRH + VCOM + VCOM_OFFSET - (0.5 * VDV)

        Valid values must be in the range of 3350 (3.35V) to 5500 (5.5V)
        in steps of 50.

# TODO  ST7796_VGH and ST7796_VGL (non linear values)

endif # ST7796_CUSTOM_CONFIG

endif # KCONFIG_USEMODULE_ST7735
```
